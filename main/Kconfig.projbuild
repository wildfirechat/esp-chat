## main/Kconfig.projbuild
```kconfig
menu "Chat app"

    config APP_CALL
        bool "Voice calls"
        default y
        help
            Whether this build can place and take voice calls.

            Calls are the AV SDK in ../wfav-esp, which is a separate module on
            purpose. Turning this off compiles main/ui_call_none.c instead of
            main/ui_call.c, so nothing calls into wfav and the whole WebRTC
            stack -- esp_peer, esp_capture, the Opus codecs, the AFE -- is
            dropped at link time: 2.4 MB of image rather than 4.9 MB. The chat
            page then has no phone button, and an invite arrives at a board
            that is not listening for one, which looks to the caller exactly
            like a board that is switched off.

            The SDK is still compiled in that case, just not linked. To leave
            it out of the build entirely, and skip downloading its managed
            components, do not have ../wfav-esp checked out at all -- then this
            has to be n, and the build says so if it is not.

    config APP_PTT
        bool "Push-to-talk (对讲)"
        default y
        help
            Whether this build can hold a button and be heard by everyone in a
            conversation.

            Push-to-talk is the SDK in ../wfptt-esp, which is a separate module
            on purpose. Turning this off compiles main/ui_ptt_none.c instead of
            main/ui_ptt.c and main/app_ptt.c, so nothing calls into wfptt and
            the module is dropped at link time. The chat page then has no 对讲
            button, and somebody talking reaches a board that is not listening
            -- which to them looks exactly like a board that is switched off.

            It is a SEPARATE switch from APP_CALL, and that is the point of
            having two. A talk is a burst of ordinary IM messages carrying
            AMR-NB, so it needs the microphone and the long link and nothing
            else: no WebRTC, no Opus, no AEC. A CONFIG_APP_CALL=n build --
            2.4 MB rather than 4.9 -- is still a walkie-talkie.

            The SDK is still compiled in that case, just not linked. To leave
            it out of the build entirely do not have ../wfptt-esp checked out
            at all -- then this has to be n, and the build says so if it is not.

    config APP_TURN_URL
        string "TURN/STUN server, overriding the AV SDK's own"
        depends on APP_CALL
        default ""
        help
            The relay a call's media goes through, for a deployment that runs
            its own. WFC does not hand this out at connect time -- it is client
            configuration, the same Config.ICE_SERVERS the web client reads.

            The AV SDK has its own default for this (CONFIG_WFAV_TURN_URL,
            wildfirechat.net's). Leave this empty and that one is used, which
            is the right thing for a board talking to the public deployment.

            It is here as well, and not only in the SDK, because the SDK is not
            always source: a build against a packaged libwfav.a has the SDK's
            Kconfig compiled into it and cannot change it. TURN is deployment
            configuration rather than SDK configuration, so the application
            gets the last word -- main/ui_call.c passes this to
            wfav_engine_start() and it wins over whatever the SDK was built
            with.

            Set the username and password below with it. A wrong or
            unreachable TURN server does not fail here; it fails as a call that
            rings, connects nothing and reports a media error.

    config APP_TURN_USER
        string "TURN username"
        depends on APP_CALL
        default ""
        help
            Only read when APP_TURN_URL is not empty.

    config APP_TURN_PASSWORD
        string "TURN password"
        depends on APP_CALL
        default ""
        help
            Only read when APP_TURN_URL is not empty. A credential: put it in
            sdkconfig.local, not here.

    config APP_SERVER_URL
        string "App server, for the QR login"
        default "https://app.wildfirechat.net"
        help
            Where the QR login talks: POST /pc_session to mint a login
            session, POST /session_login/<token> to wait for a phone to
            confirm it (app_login.h). It is the deployment's *app* server --
            the one the phone app calls AppService.APP_SERVER_ADDRESS -- and
            not the IM server in WFC_HOST below; a deployment usually runs
            both, on different ports.

            https here means the clock has to be right before the first
            request, which it is: the boot path syncs SNTP before it asks.

            Only consulted by a board with no stored account. A board
            configured through sdkconfig.local never calls it.

    config APP_WIFI_SSID
        string "WiFi SSID, for the first boot only"
        default ""
        help
            A seed for NVS, not the setting itself. The board stores the
            network it is on (app_cfg.h), and this is what a blank store is
            filled with on the first boot -- so a bench board with a
            sdkconfig.local comes up on your desk's WiFi as it always did, and
            a board without one shows a QR code and asks a phone instead
            (app_net.h).

            Which means changing this later does nothing: NVS already has a
            value and it wins. The status page has a button that clears it
            and restarts, which is how a board is moved to another network.

    config APP_WIFI_PASSWORD
        string "WiFi password, for the first boot only"
        default ""

    config APP_SNTP_SERVER
        string "SNTP server"
        default "ntp.aliyun.com"
        help
            The clock is not optional here. Every encrypted payload carries an
            "hours since 2018-01-01" prefix that the server checks, so the app
            waits for a real time sync before it will talk to the IM server --
            there is no uptime fallback like mqtt_box has.

    config APP_TIMEZONE
        string "POSIX timezone"
        default "CST-8"

    config APP_VOICE_VOLUME
        int "Voice message playback volume (%)"
        range 0 100
        default 80
        help
            How loud a received voice message is played. Separate from a
            call's volume: a call is held near the face and a voice message
            is played across a desk, so the two want different numbers and
            the AV SDK is not always compiled in to take one from.


    config WFC_ROUTE_PORT
        int "Route HTTP port"
        default 80
        range 1 65535

    config WFC_USER_ID
        string "User ID, for the first boot only"
        default ""
        help
            Set this in sdkconfig.local together with the client ID and token.

            Like the WiFi above, this seeds NVS on a first boot and is ignored
            afterwards. Leave it empty and the board asks a phone to scan a
            login QR code instead (app_login.h), which is the path that does
            not need a token minted by hand.

    config WFC_CLIENT_ID
        string "Client ID"
        default ""
        help
            The token is issued FOR a specific client ID -- pairing a token
            with any other client ID fails /route with status 1
            (kEcServerSecrectKeyMismatch). This is the single easiest thing to
            get wrong when bringing a new board up.

            Leave empty to derive a stable ID from the WiFi MAC (decision D2),
            which is what a real deployment wants; but a MAC-derived ID will
            not work with a token minted for a different one.

            Decided once, on the first boot, and stored from then on
            (app_cfg.h): the QR login sends it when it creates the session, so
            the token that comes back is minted for it, and a board that later
            changed its mind would have thrown that account away.

    config WFC_TOKEN
        string "App-server token"
        default ""
        help
            The base64 blob the app server returns. It decrypts (root key) to
            userToken|privateSecret|dbSecret. Treat it as a credential: put it
            in sdkconfig.local, not here.

            Seeds NVS on the first boot, like the user ID above, and is what
            the QR login writes there when there is no seed to take.

            The token also carries a platform, and the server keeps it on the
            session. It has to match WFC_PLATFORM in wfc_platform.h, which is
            a native platform on purpose -- ask for the token accordingly. A
            token issued for the Web platform will route, but /route will then
            hand back a WebSocket port this client cannot speak.

    config WFC_PULL_HISTORY
        bool "Pull message history on first connect"
        default y
        help
            Only consulted when the local store has no head yet: a first boot,
            a store wiped because the account changed, or any boot at all with
            CONFIG_WFC_STORE_RAM. With a head in the store the client resumes
            from it and this setting does not come up.

            y starts at 0 and pulls whatever roaming history the server kept.
            That is what gives a board that has just logged in a conversation
            list at all: the list is a projection of the message table
            (touch_conversation() in wfc_store.c), so with no messages there
            are no conversations, and the 会话 page stays empty until somebody
            types. Pulling the roaming window is also what every other client
            does on a fresh install, which is why it is the default.

            n starts at the head the CONNACK reports instead: only messages
            sent from now on arrive. Pick it for a board that only has to show
            live traffic.

            Bounded either way by the pull-round limit in wfc_impl.c, so a
            busy account cannot pull forever -- and by the server's retention
            window, which is how far back "roaming" reaches in the first place.

endmenu
```
